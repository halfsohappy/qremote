## sdkconfig.defaults
```kconfig
# Target
CONFIG_IDF_TARGET="esp32s3"

# TinyUSB — composite device: CDC (serial console) + NCM (USB ethernet).
# CDC carries ESP_LOG output so we can debug over the same USB-C cable
# that provides the network link.
CONFIG_TINYUSB=y
CONFIG_TINYUSB_NET_MODE_NCM=y
CONFIG_TINYUSB_NET_MODE_ECM_RNDIS=n
CONFIG_TINYUSB_NET_MODE_NONE=n
CONFIG_TINYUSB_CDC_ENABLED=y
CONFIG_TINYUSB_CDC_COUNT=1
CONFIG_TINYUSB_MSC_ENABLED=n
CONFIG_TINYUSB_HID_ENABLED=n

# Early boot console goes to UART0 (pre-TinyUSB). Those early messages will
# be lost since the FeatherS3 has no UART bridge — acceptable. After
# tinyusb_driver_install runs, esp_tusb_init_console() redirects stdout/
# stderr to the TinyUSB CDC interface for the rest of the firmware's life.
CONFIG_ESP_CONSOLE_UART_DEFAULT=y

# lwIP — DHCP server support (we serve the host) and a reasonable socket budget.
CONFIG_LWIP_DHCPS=y
CONFIG_LWIP_IPV4_NAPT=n
CONFIG_LWIP_MAX_SOCKETS=10

# mDNS — let QLab resolve qremote.local.
# We have no WiFi STA/AP — disable their predefined interface slots so our
# custom USB-NCM netif can be registered via mdns_register_netif().
# Without this, mdns_register_netif returns ESP_ERR_NO_MEM (all slots
# reserved for predefined interfaces we don't use).
CONFIG_MDNS_MAX_SERVICES=10
CONFIG_MDNS_MAX_INTERFACES=2
CONFIG_MDNS_PREDEF_NETIF_STA=n
CONFIG_MDNS_PREDEF_NETIF_AP=n

# Log level — bump if noisy.
CONFIG_LOG_DEFAULT_LEVEL_INFO=y
```

## sdkconfig.defaults.waveshare_amoled
```kconfig
# Waveshare ESP32-S3-Touch-AMOLED-1.64 — deltas over sdkconfig.defaults.

# 16 MB flash (board has 16 MB QSPI). Also pick a partition table that fits.
CONFIG_ESPTOOLPY_FLASHSIZE_16MB=y
CONFIG_ESPTOOLPY_FLASHSIZE="16MB"
CONFIG_PARTITION_TABLE_SINGLE_APP_LARGE=y

# Octal PSRAM at 80 MHz — needed for LVGL framebuffers; board ships 8 MB PSRAM.
CONFIG_SPIRAM=y
CONFIG_SPIRAM_MODE_OCT=y
CONFIG_SPIRAM_SPEED_80M=y
CONFIG_SPIRAM_USE_MALLOC=y
CONFIG_SPIRAM_MALLOC_ALWAYSINTERNAL=16384
CONFIG_SPIRAM_TRY_ALLOCATE_WIFI_LWIP=y

# Enable display support — pulls in lvgl + esp_lcd_sh8601 codepaths in our
# main component. Feathers3 env leaves this unset so its build stays lean.
CONFIG_QREMOTE_HAS_DISPLAY=y

# LVGL — RGB565 panel, default features + a larger title font.
CONFIG_LV_COLOR_DEPTH_16=y
CONFIG_LV_USE_LABEL=y
CONFIG_LV_USE_TEXTAREA=y
CONFIG_LV_FONT_MONTSERRAT_20=y

# Bump main task stack for LVGL init + UI creation.
CONFIG_ESP_MAIN_TASK_STACK_SIZE=8192
```

## src/Kconfig.projbuild
```kconfig
menu "qremote"

config QREMOTE_HAS_DISPLAY
    bool "Enable AMOLED display output (Waveshare 1.64\" SH8601)"
    default n
    help
        When enabled, pulls in LVGL + esp_lcd_sh8601 and shows network
        status + incoming OSC messages on the 280x456 AMOLED. Intended
        for the waveshare_amoled PlatformIO env. The feathers3 env has
        no display, so this should remain disabled there.

endmenu
```
